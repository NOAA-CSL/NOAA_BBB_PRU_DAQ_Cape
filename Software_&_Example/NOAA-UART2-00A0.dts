/dts-v1/;

/ {
	compatible = "ti,beaglebone", "ti,beaglebone-black";
	part-number = "NOAA-UART2";
	version = "00A0";
	exclusive-use = "P9.22", "P9.21", "uart2";

	fragment@0 {
		target = <0xdeadbeef>;

		__overlay__ {

			pinmux_bb_uart2_pins {
				pinctrl-single,pins = <0x150 0x21 0x154 0x01>;
				linux,phandle = <0x1>;
				phandle = <0x1>;
			};
		};
	};

	fragment@1 {
		target = <0xdeadbeef>;

		__overlay__ {
			status = "okay";
			pinctrl-names = "default";
			pinctrl-0 = <0x1>;
		};
	};

	__symbols__ {
		bb_uart2_pins = "/fragment@0/__overlay__/pinmux_bb_uart2_pins";
	};

	__fixups__ {
		am33xx_pinmux = "/fragment@0:target:0";
		uart3 = "/fragment@1:target:0";
	};

	__local_fixups__ {
		fixup = "/fragment@1/__overlay__:pinctrl-0:0";
	};
};

/* PRU1 pins for parallel 16-bit data read as two 
 * bytes with byte select, data ready and over/under
 * flow. PRU0 pins for PWM output.
 */

/dts-v1/;
/plugin/;

/ 
{
	compatible = "ti,beaglebone", "ti,beaglebone-black";
	part-number = "NOAA-POPS";
	version = "00A0";
	
	exclusive-use = 
	   "P9.25", 
	   "P9.41", 
	   "P9.27", 
	   "P9.42", 
	   "P9.28", 
	   "P9.30", 
	   "P9.29", 
	   "P9.31", 
	   "P8.30",
	   "P8.28",
	   "P8.29", 
	   "P8.27", 
	   "P8.40", 
	   "P8.39", 
	   "P8.42", 
	   "P8.41", 
	   "P8.44", 
	   "P8.43", 
	   "P8.46", 
	   "P8.45", 
	   "pru0", 
	   "pru1";

	fragment@0 
	   {
		target = <&am33xx_pinmux>;

		__overlay__ 
		   {
			pru_pru_pins: pinmux_pru_pru_pins 
			   {
				   pinctrl-single,pins = <
				      0x1ac 0x26  // pr1_pru0_pru_r31_7 | fast, input,  pulldown, enable, mode 6 | spare 
				      0x1a8 0x26  // pr1_pru0_pru_r31_6 | fast, input,  pulldown, enable, mode 6 | spare
				      0x1a4 0x26  // pr1_pru0_pru_r31_5 | fast, input,  pulldown, enable, mode 6 | spare
				      0x1a0 0x26  // pr1_pru0_pru_r31_4 | fast, input,  pulldown, enable, mode 6 | spare
				      0x19c 0x26  // pr1_pru0_pru_r31_3 | fast, input,  pulldown, enable, mode 6 | spare  
				      0x198 0x26  // pr1_pru0_pru_r31_2 | fast, input,  pulldown, enable, mode 6 | STOP_PRU0
				      0x194 0x5   // pr1_pru0_pru_r30_1 | fast, output, pulldown, enable, mode 5 | PWM_1
				      0x190 0x5   // pr1_pru0_pru_r30_0 | fast, output, pulldown, enable, mode 5 | PWM_0
				      0xec 0x26   // pr1_pru1_pru_r31_11| fast, input,  pulldown, enable, mode 6 | STOP_PRU1
				      oxe8 0x5    // pr1)pru1_pru_r30_10| fast, output, pulldown, enable, mode 5 | Byte Select (0=low, 1=high)
				      0xe4 0x26   // pr1_pru1_pru_r31_9 | fast, input,  pulldown, enable, mode 6 | Over/Under flow bit
				      0xe0 0x26   // pr1_pru1_pru_r31_8 | fast, input,  pulldown, enable, mode 6 | Data Ready bit
				      0xbc 0x26   // pr1_pru1_pru_r31_7 | fast, input,  pulldown, enable, mode 6 | high byte, bit 7
				      0xb8 0x26   // pr1_pru1_pru_r31_6 | fast, input,  pulldown, enable, mode 6 | high byte, bit 6
				      0xb4 0x26   // pr1_pru1_pru_r31_5 | fast, input,  pulldown, enable, mode 6 | high byte, bit 5
				      0xb0 0x26   // pr1_pru1_pru_r31_4 | fast, input,  pulldown, enable, mode 6 | high byte, bit 4
				      0xac 0x26   // pr1_pru1_pru_r31_3 | fast, input,  pulldown, enable, mode 6 | high byte, bit 3
				      0xa8 0x26   // pr1_pru1_pru_r31_2 | fast, input,  pulldown, enable, mode 6 | high byte, bit 2
				      0xa4 0x26   // pr1_pru1_pru_r31_1 | fast, input,  pulldown, enable, mode 6 | high byte, bit 1
				      0xa0 0x26   // pr1_pru1_pru_r31_0 | fast, input,  pulldown, enable, mode 6 | high byte, bit 0
				   >;
			   };
		   };
	   };
   fragment@1 {         // Enable the PRUSS
      target = <&pruss>;
      __overlay__ {
         status = "okay";
         pinctrl-names = "default";
         pinctrl-0 = <&pru_pru_pins>;
      };
   };

};
